## config/boards/shields/silicon65/Kconfig.defconfig
```kconfig
# Copyright (c) 2020 The ZMK Contributors
# SPDX-License-Identifier: MIT

if SHIELD_SILICON65

config ZMK_KEYBOARD_NAME
	default "Silicon65-X"

endif
```

## config/west.yml
```yaml
manifest:
  remotes:
    - name: zmkfirmware
      url-base: https://github.com/zmkfirmware
    - name: bvbhu-zmk-qmk-rgb-matrix
      url-base: https://github.com/bvbhu
  projects:
    - name: zmk
      remote: zmkfirmware
      revision: v0.3.0
      import: app/west.yml
    - name: zmk-qmk-rgb-matrix
      remote: bvbhu-zmk-qmk-rgb-matrix
      revision: main
      path: modules/rgb-matrix
  self:
    path: config
```
