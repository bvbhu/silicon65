## Assets/silicon65/Kconfig.defconfig
```kconfig
# Copyright (c) 2020 The ZMK Contributors
# SPDX-License-Identifier: MIT

if SHIELD_SILICON65

config ZMK_KEYBOARD_NAME
	default "silicon65"

endif
```

## Assets/silicon65/Kconfig.shield
```kconfig
# Copyright (c) 2020 The ZMK Contributors
# SPDX-License-Identifier: MIT

config SHIELD_SILICON65
	def_bool $(shields_list_contains,silicon65)
```
